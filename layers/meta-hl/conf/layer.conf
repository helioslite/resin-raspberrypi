## layers/meta-hl/conf/layer.conf
```bitbake
BBPATH .= ":${LAYERDIR}"

BBFILES += "${LAYERDIR}/recipes-*/*/*.bb \
            ${LAYERDIR}/recipes-*/*/*.bbappend"

BBFILE_COLLECTIONS += "hl"
BBFILE_PATTERN_hl = "^${LAYERDIR}/"

LAYERVERSION_hl = "1"
LAYERDEPENDS_hl = "resin-common"
```
